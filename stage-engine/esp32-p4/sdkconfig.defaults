## stage-engine/esp32-p4/sdkconfig.defaults
```kconfig
# Showduino Stage Engine default ESP-IDF configuration
# Target: Waveshare ESP32-P4-Module-DEV-KIT

CONFIG_IDF_TARGET="esp32p4"

# Use USB Serial/JTAG as the main console where supported.
CONFIG_ESP_CONSOLE_USB_SERIAL_JTAG=y
CONFIG_ESP_CONSOLE_SECONDARY_NONE=y

# Enable external PSRAM support on the ESP32-P4 module.
CONFIG_SPIRAM=y
CONFIG_SPIRAM_USE_MALLOC=y
CONFIG_SPIRAM_MALLOC_ALWAYSINTERNAL=16384
CONFIG_SPIRAM_MALLOC_RESERVE_INTERNAL=32768

# Keep watchdog protection enabled for live-show reliability.
CONFIG_ESP_TASK_WDT_EN=y
CONFIG_ESP_TASK_WDT_INIT=y
CONFIG_ESP_TASK_WDT_TIMEOUT_S=5
CONFIG_ESP_TASK_WDT_CHECK_IDLE_TASK_CPU0=y
CONFIG_ESP_TASK_WDT_CHECK_IDLE_TASK_CPU1=y

# Logging defaults suitable for bring-up and debugging.
CONFIG_LOG_DEFAULT_LEVEL_INFO=y
CONFIG_LOG_MAXIMUM_LEVEL_DEBUG=y
CONFIG_LOG_TIMESTAMP_SOURCE_RTOS=y
CONFIG_COMPILER_OPTIMIZATION_DEBUG=y

# FreeRTOS timing.
CONFIG_FREERTOS_HZ=1000

# Use a large application partition while the Stage Engine grows.
CONFIG_PARTITION_TABLE_SINGLE_APP_LARGE=y
```
